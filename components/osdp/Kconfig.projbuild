## components/osdp/Kconfig.projbuild
```kconfig
menu "OSDP Configuration"

    config OSDP_UART_NUM
        int "OSDP UART Number"
        default 2
        range 0 2
        help
            UART port number to use for OSDP communication.

    config OSDP_RS485_DE_GPIO
        int "RS485 DE (Driver Enable) GPIO"
        default 12
        range 0 39
        help
            GPIO pin for RS485 Driver Enable (DE) signal.

    config OSDP_RS485_DI_GPIO
        int "RS485 DI (Driver Input) GPIO"
        default 33
        range 0 39
        help
            GPIO pin for RS485 Driver Input (DI) signal.

    config OSDP_RS485_RO_GPIO
        int "RS485 RO (Receiver Output) GPIO"
        default 39
        range 0 39
        help
            GPIO pin for RS485 Receiver Output (RO) signal.

    config OSDP_RS485_RE_GPIO
        int "RS485 RE (Receiver Enable) GPIO"
        default 32
        range 0 39
        help
            GPIO pin for RS485 Receiver Enable (RE) signal.

    config OSDP_BAUD_RATE
        int "OSDP Baud Rate"
        default 9600
        help
            Baud rate for OSDP communication. Standard OSDP supports:
            9600, 19200, 38400, 115200, 230400

    choice OSDP_BAUD_RATE_CHOICE
        prompt "OSDP Baud Rate Selection"
        default OSDP_BAUD_9600
        help
            Select the baud rate for OSDP communication.

        config OSDP_BAUD_9600
            bool "9600 bps"
        config OSDP_BAUD_19200
            bool "19200 bps"
        config OSDP_BAUD_38400
            bool "38400 bps"
        config OSDP_BAUD_115200
            bool "115200 bps"
        config OSDP_BAUD_230400
            bool "230400 bps"
    endchoice

    config OSDP_PD_ADDRESS
        int "OSDP PD Address"
        default 1
        range 0 127
        help
            Peripheral Device address for OSDP communication.
            Valid range is 0-127 (7-bit address).

    config OSDP_ENABLE_SECURE_CHANNEL
        bool "Enable OSDP Secure Channel"
        default y
        help
            Enable OSDP Secure Channel (SC) for encrypted communication.

    config OSDP_SCBK
        string "OSDP Secure Channel Base Key (hex)"
        default "000102030405060708090A0B0C0D0E0F"
        depends on OSDP_ENABLE_SECURE_CHANNEL
        help
            16-byte Secure Channel Base Key in hexadecimal format.
            Must be exactly 32 hex characters (16 bytes).

endmenu 
```

## main/Kconfig.projbuild
```kconfig
menu "Access Control Node Configuration"
    config EXAMPLE_ETH_DEINIT_AFTER_S
        int "Stop and deinit Ethernet after elapsing number of secs"
        range -1 300
        default -1
        help
            This option is for demonstration purposes only to demonstrate deinitialization of the Ethernet driver.
            Set to -1 to not deinitialize.
endmenu

menu "OTA Configuration"

    config OTA_UPDATE_URL
        string "OTA Update URL"
        default "https://your-ota-server.com/firmware.bin"
        help
            HTTPS URL where the firmware update can be downloaded from.
            The URL should point to a binary file that can be flashed to the device.

    config OTA_UPDATE_TIMEOUT_MS
        int "OTA Update Timeout (ms)"
        default 10000
        range 5000 60000
        help
            Timeout in milliseconds for OTA update operations.

    config OTA_SKIP_CERT_COMMON_NAME_CHECK
        bool "Skip Certificate Common Name Check"
        default n
        help
            Skip checking the common name in the server certificate.
            Only enable this for testing purposes.
            WARNING: This reduces security and should only be used for development/testing.

    config OTA_AUTO_UPDATE_ENABLED
        bool "Enable Automatic OTA Updates"
        default n
        help
            Automatically check for and download OTA updates when Ethernet is connected.

    config OTA_AUTO_UPDATE_INTERVAL_S
        int "Auto Update Check Interval (seconds)"
        default 3600
        range 300 86400
        depends on OTA_AUTO_UPDATE_ENABLED
        help
            Interval in seconds between automatic OTA update checks.

    config EMBED_SERVER_CERT
        bool "Embed Server Certificate"
        default y
        help
            Embed the server certificate in the firmware binary.
            The certificate file should be placed in the 'certs' directory.

    config EMBED_CLIENT_CERT
        bool "Embed Client Certificate"
        default n
        help
            Embed client certificate and private key in the firmware binary.
            The certificate and key files should be placed in the 'certs' directory.

endmenu
```
